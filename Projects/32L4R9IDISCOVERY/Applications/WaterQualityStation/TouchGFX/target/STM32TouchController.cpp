/* USER CODE BEGIN Header */
/**
  ******************************************************************************
  * File Name          : STM32TouchController.cpp
  ******************************************************************************
  * This file is generated by TouchGFX Generator 4.19.1.
  ******************************************************************************
  * @attention
  *
  * Copyright (c) 2022 STMicroelectronics.
  * All rights reserved.
  *
  * This software is licensed under terms that can be found in the LICENSE file
  * in the root directory of this software component.
  * If no LICENSE file comes with this software, it is provided AS-IS.
  *
  ******************************************************************************
  */
/* USER CODE END Header */

/* USER CODE BEGIN STM32TouchController */
#include <STM32TouchController.hpp>
#include <ft3x67.h>
#include <stm32l4xx.h>
#include "cmsis_os.h"

#define I2C1_TIMEOUT_MAX        3000
#define SQRT_2                  1.4142135623730950488016887242097f /* sqrt(2) */
#define TOUCHQUEUEOBJECTS       1
osMessageQueueId_t mid_MsgQueue;
extern I2C_HandleTypeDef hi2c1;

static uint8_t HwRotation = 0;

typedef struct
{
    uint8_t  touchDetected;                /*!< Total number of active touches detected at last scan */
    uint16_t touchX;
    uint16_t touchY;      /*!< Touch Y[0], Y[1] coordinates on 12 bits */
} TS_StateTypeDef;

void TS_DetectState(TS_StateTypeDef* TS_State);

extern osSemaphoreId_t touchBinarySemHandle;

void STM32TouchController::init()
{
    /**
     * Initialize touch controller and driver
     *
     */
    ft3x67_ts_drv.Init(TS_I2C_ADDRESS);
    /* Configure and Start the TouchScreen driver */
    ft3x67_ts_drv.Start(TS_I2C_ADDRESS);

    ft3x67_ts_drv.DisableIT(TS_I2C_ADDRESS);

    if (TS_IO_Read(STM32TouchController::TS_I2C_ADDRESS, FT3X67_FIRMID_REG) != 0x01)
    {
        HwRotation = 1;
    }

}

bool STM32TouchController::sampleTouch(int32_t& x, int32_t& y)
{
    /**
     * By default sampleTouch returns false,
     * return true if a touch has been detected, otherwise false.
     *
     * Coordinates are passed to the caller by reference by x and y.
     *
     * This function is called by the TouchGFX framework.
     * By default sampleTouch is called every tick, this can be adjusted by HAL::setTouchSampleRate(int8_t);
     *
     */
    TS_StateTypeDef state;
    TS_DetectState(&state);
    if (state.touchDetected)
    {
        x = state.touchX;
        y = state.touchY;
        return true;
    }
    return false;
}

void TS_DetectState(TS_StateTypeDef* TS_State)
{
    static uint32_t xf; /* Final x value */
    static uint32_t yf; /* Final y value */
    int16_t  xc, yc;   /* Coordinates transfered to center screen */
    int16_t  xr, yr;   /* Coordinates after rotation */
    uint16_t x;        /* Initial x value */
    uint16_t y;        /* Initial y value */

    /* Reading touch coordinates from touchcontroller */
    TS_State->touchDetected = ft3x67_ts_drv.DetectTouch(STM32TouchController::TS_I2C_ADDRESS);
    if (TS_State->touchDetected)
    {
        ft3x67_ts_drv.GetXY(STM32TouchController::TS_I2C_ADDRESS, (uint16_t*)&x, (uint16_t*)&y);

        if (HwRotation == 0)
        {
            /* First translate coordonates to center screen */
            xc = x - 195;
            yc = y - 195;

            /* Apply rotation of 45 */
            xr = (int16_t)(SQRT_2 * (xc - yc) / 2);
            yr = (int16_t)(SQRT_2 * (xc + yc) / 2);

            /* Revert the initial translation */
            xf = xr + 195;
            yf = yr + 195;

            TS_State->touchX = (uint16_t)xf;
            TS_State->touchY = (uint16_t)yf;
        }
        else
        {
            TS_State->touchX = x;
            TS_State->touchY = y;
        }
    }
}

/************************** LINK TS (TouchScreen) *****************************/
/**
  * @brief  Initializes Touchscreen low level.
  * @retval None
  */
void TS_IO_Init(void)
{
    /* Done in main */
}

/**
  * @brief  Writes a single data.
  * @param  Addr: I2C address
  * @param  Reg: Reg address
  * @param  Value: Data to be written
  * @retval None
  */
void TS_IO_Write(uint8_t Addr, uint8_t Reg, uint8_t Value)
{
    HAL_I2C_Mem_Write(&hi2c1, Addr, (uint16_t)Reg, I2C_MEMADD_SIZE_8BIT, (uint8_t*)&Value, 1, I2C1_TIMEOUT_MAX);
}

/**
  * @brief  Reads a single data.
  * @param  Addr: I2C address
  * @param  Reg: Reg address
  * @retval Data to be read
  */
uint8_t TS_IO_Read(uint8_t Addr, uint8_t Reg)
{
    uint8_t value = 0x0;
    HAL_I2C_Mem_Read(&hi2c1, Addr, Reg, I2C_MEMADD_SIZE_8BIT, &value, 1, I2C1_TIMEOUT_MAX);
    return value;
}

/**
  * @brief  Reads multiple data with I2C communication
  *         channel from TouchScreen.
  * @param  Addr: I2C address
  * @param  Reg: Register address
  * @param  Buffer: Pointer to data buffer
  * @param  Length: Length of the data
  * @retval Number of read data
  */
uint16_t TS_IO_ReadMultiple(uint8_t Addr, uint8_t Reg, uint8_t* Buffer, uint16_t Length)
{
    return HAL_I2C_Mem_Read(&hi2c1, Addr, (uint16_t)Reg, I2C_MEMADD_SIZE_8BIT, Buffer, Length, I2C1_TIMEOUT_MAX);
}

/**
  * @brief  Writes multiple data with I2C communication
  *         channel from MCU to TouchScreen.
  * @param  Addr: I2C address
  * @param  Reg: Register address
  * @param  Buffer: Pointer to data buffer
  * @param  Length: Length of the data
  * @retval None
  */
void TS_IO_WriteMultiple(uint8_t Addr, uint8_t Reg, uint8_t* Buffer, uint16_t Length)
{
    HAL_I2C_Mem_Write(&hi2c1, Addr, (uint16_t)Reg, I2C_MEMADD_SIZE_8BIT, Buffer, Length, I2C1_TIMEOUT_MAX);
}

/* USER CODE END STM32TouchController */

/************************ (C) COPYRIGHT STMicroelectronics *****END OF FILE****/
